## boards/shields/pokop/Kconfig.defconfig
```kconfig
if SHIELD_POKOP_LEFT

config ZMK_KEYBOARD_NAME
    default "pokop"
    
config ZMK_SPLIT_ROLE_CENTRAL
    default y

endif

if SHIELD_POKOP_LEFT || SHIELD_POKOP_RIGHT

config ZMK_SPLIT
    default y
   
endif
```

## boards/shields/pokop/Kconfig.shield
```kconfig
config SHIELD_POKOP_LEFT
    def_bool $(shields_list_contains,pokop_left)

config SHIELD_POKOP_RIGHT
    def_bool $(shields_list_contains,pokop_right)
```
